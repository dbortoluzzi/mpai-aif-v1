## west/west.yml
```yaml
# Copyright (c) 2021 Nordic Semiconductor ASA
# SPDX-License-Identifier: Apache-2.0

manifest:
  self:
    path: west

  remotes:
    - name: zephyrproject-rtos
      url-base: https://github.com/zephyrproject-rtos
    - name: pubsub-lib
      url-base: https://github.com/dbortoluzzi
    - name: cJSON-lib
      url-base: https://github.com/DaveGamble
  projects:
    - name: zephyr
      remote: zephyrproject-rtos
      revision: v2.7.1
      import: true
      path: wzephyr
    - name: pubsub
      remote: pubsub-lib
      revision: master
      path: lib/pubsub
    - name: cJSON
      remote: cJSON-lib
      revision: master
      path: lib/cJSON
      
```

## zephyr/Kconfig
```kconfig
mainmenu "APP_MPAI_AIF"

source "Kconfig.zephyr"
config APP_MPAI_AIF_STM32
  default y
  bool
  select USE_STM32_HAL_GPIO
  select USE_STM32_HAL_GPIO_EX
  select USE_STM32_HAL_CORTEX
  select USE_STM32_HAL_DFSDM
  select USE_STM32_HAL_DFSDM_EX
  select USE_STM32_HAL_DMA
  select USE_STM32_HAL_DMA_EX
  select USE_STM32_HAL_DMA2D

config COAP_SERVER
	bool "Enable COAP Server"
	default n
	help
	  Enable COAP Server

config COAP_SERVER_IPV4_ADDR
	string "Destination of the COAP Server"
	depends on COAP_SERVER
	help
	  IPV4 Address used to connect to COAP Server

config COAP_SERVER_PORT
	int "Port of the COAP Server"
	depends on COAP_SERVER
	default 5683
	help
	  Port used to connect to COAP Server

config MPAI_CONFIG_STORE
	bool "Enable reading configuration from MPAI Config Store"
	default y
	help
	  MPAI Config Store protocol used

config MPAI_CONFIG_STORE_USES_COAP
	bool "Enable reading configuration from MPAI Config Store using COAP"
	depends on MPAI_CONFIG_STORE
	select COAP_SERVER
	help
	  MPAI Config Store uses COAP protocol

config MPAI_AIM_CONTROL_UNIT_SENSORS
	bool "Enable reading data from MPAI AIM CONTROL UNIT SENSORS"
	default y
	help
	  This will reading data from configured sensors of mcu.

config MPAI_AIM_CONTROL_UNIT_SENSORS_PERIODIC
	bool "Enable periodic reading data from MPAI AIM CONTROL UNIT SENSORS"
	default n
	help
	  This will reading data from sensors of mcu in a periodic way (at the moment, with a period of 5000ms).


config MPAI_AIM_MOTION_RECOGNITION_ANALYSIS
	bool "Enable motion recognition analysis, reading data from inertial unit of mcu"
    depends on MPAI_AIM_CONTROL_UNIT_SENSORS
	default y
	help
	  This will store messages like "MCU HAS STOPPED" or "MCU HAS STARTED TO MOVE".    

config MPAI_AIM_VOLUME_PEAKS_ANALYSIS
	bool "Enable volume peaks analysis, reading data from mic of mcu"
	default y
	help
	  This will store messages like "VOLUME PEAK DETECTED". 
    

config MPAI_AIM_VALIDATION_MOVEMENT_WITH_AUDIO
	bool "Enable validation of rehabilitation exercises, in according with audio volume peak"
  depends on MPAI_AIM_VOLUME_PEAKS_ANALYSIS
  depends on MPAI_AIM_MOTION_RECOGNITION_ANALYSIS
	default y
	help
	  This will notify to the users (blinking the leds) when the rehabilitation exercises are doing in wrong way

config MPAI_AIM_TEMP_LIMIT
	bool "Enable check on temperature value"
  depends on MPAI_AIM_CONTROL_UNIT_SENSORS
	default n
	help
	  This will notify to the users (blinking the leds) if the temperature exceeds 30.0C°


config APP_TEST_WRITE_TO_FLASH
	bool "Enable test write to flash memory"
	default n
	help
	  This will write a test json string to the flash memory 
```
