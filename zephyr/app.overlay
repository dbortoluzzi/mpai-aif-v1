/*
 * Copyright (c) 2022 University of Turin, Daniele Bortoluzzi <danieleb88@gmail.com> 
 *
 * SPDX-License-Identifier: Apache-2.0
 */

/* Value of msi-range overwritten to permit to run microphone and sensors at the same time */ 
&clk_msi {
	msi-range = <10>;
	status = "okay";
};
  
/* Values of div-m, mul-n, div-p, div-q, div-r and clocks overwritten to permit to run microphone */ 
&pll {
	compatible = "st,stm32l4-pll-clock";
	div-m = <6>;
	mul-n = <43>;
	div-p = <7>;
	div-q = <2>;
	div-r = <4>;
	clocks = <&clk_msi>;
	status = "okay";
 };
  